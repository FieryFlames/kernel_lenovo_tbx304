/* Copyright (c) 2013, The Linux Foundation. All rights reserved.
 *
 * This program is free software; you can redistribute it and/or modify
 * it under the terms of the GNU General Public License version 2 and
 * only version 2 as published by the Free Software Foundation.
 *
 * This program is distributed in the hope that it will be useful,
 * but WITHOUT ANY WARRANTY; without even the implied warranty of
 * MERCHANTABILITY or FITNESS FOR A PARTICULAR PURPOSE.  See the
 * GNU General Public License for more details.
 */

/*---------------------------------------------------------------------------
 * This file is autogenerated file using gcdb parser. Please do not edit it.
 * Update input XML file to add a new entry or update variable in this file
 * VERSION = "1.0"
 *---------------------------------------------------------------------------*/
&mdss_mdp {
	dsi_nt35521s_boe_wxga_video: qcom,mdss_dsi_nt35521s_boe_wxga_video {
		qcom,mdss-dsi-panel-name = "nt35521s boe wxga video mode dsi panel";
		qcom,mdss-dsi-panel-controller = <&mdss_dsi0>;
		qcom,mdss-dsi-panel-type = "dsi_video_mode";
		qcom,mdss-dsi-panel-destination = "display_1";
		qcom,mdss-dsi-panel-framerate = <60>;
		qcom,mdss-dsi-virtual-channel-id = <0>;
		qcom,mdss-dsi-stream = <0>;
		qcom,mdss-dsi-panel-width = <800>;
		qcom,mdss-dsi-panel-height = <1280>;
		qcom,mdss-dsi-h-front-porch = <200>;
		qcom,mdss-dsi-h-back-porch = <80>;
		qcom,mdss-dsi-h-pulse-width = <4>;
		qcom,mdss-dsi-h-sync-skew = <0>;
		qcom,mdss-dsi-v-back-porch = <16>;
		qcom,mdss-dsi-v-front-porch = <20>;
		qcom,mdss-dsi-v-pulse-width = <4>;
		qcom,mdss-dsi-h-left-border = <0>;
		qcom,mdss-dsi-h-right-border = <0>;
		qcom,mdss-dsi-v-top-border = <0>;
		qcom,mdss-dsi-v-bottom-border = <0>;
		qcom,mdss-dsi-bpp = <24>;
		qcom,mdss-dsi-color-order = "rgb_swap_rgb";
		qcom,mdss-dsi-underflow-color = <0xff>;
		qcom,mdss-dsi-border-color = <0>;
		qcom,mdss-dsi-pixel-packing = "tight";
		qcom,mdss-dsi-pixel-alignment = <0>;
		qcom,mdss-dsi-on-command = [29 01 00 00 00 00 05 FF AA 55 25 01
			29 01 00 00 01 00 02 FC 08
			29 01 00 00 00 00 02 FC 00
			29 01 00 00 14 00 05 FF AA 55 25 00 
			29 01 00 00 00 00 06 F0 55 AA 52 08 00
			29 01 00 00 00 00 03 B1 68 07
			29 01 00 00 00 00 05 B8 01 02 02 02
			29 01 00 00 00 00 02 B6 11
			29 01 00 00 00 00 03 BB 63 63
 			29 01 00 00 00 00 03 BC 00 00
			29 01 00 00 00 00 06 BD 02 BB 11 10 00
			29 01 00 00 00 00 02 C8 80
			29 01 00 00 00 00 06 F0 55 AA 52 08 01
			29 01 00 00 00 00 03 B3 28 28
			29 01 00 00 00 00 03 B4 14 14
			29 01 00 00 00 00 03 B9 44 44 
			29 01 00 00 00 00 03 BA 24 24
			29 01 00 00 00 00 03 BC 78 00
			29 01 00 00 00 00 03 BD 78 00
			29 01 00 00 00 00 06 F0 55 AA 52 08 02
			29 01 00 00 00 00 02 EE 01
			29 01 00 00 00 00 11 B0 00 00 00 1A 00 40 00 5C 00 75 00 9D 00 BD 00 F1
			29 01 00 00 00 00 11 B1 01 1A 01 59 01 8A 01 D6 02 13 02 15 02 4B 02 84
			29 01 00 00 00 00 11 B2 02 A8 02 DC 02 F6 03 26 03 43 03 6C 03 86 03 A1
			29 01 00 00 00 00 05 B3 03 BA 03 FF 
			29 01 00 00 00 00 06 F0 55 AA 52 08 03 
			
			29 01 00 00 00 00 03 B0 00 00
			29 01 00 00 00 00 03 B1 00 00
			29 01 00 00 00 00 06 B2 05 01 55 00 1A
			29 01 00 00 00 00 06 BA 53 01 55 00 3A
			29 01 00 00 00 00 02 C4 60
			29 01 00 00 00 00 02 C5 40
			29 01 00 00 00 00 06 F0 55 AA 52 08 04
			29 01 00 00 00 00 05 B1 03 02 05 07
			29 01 00 00 00 00 06 F0 55 AA 52 08 05
			29 01 00 00 00 00 06 BD 01 01 00 00 03
			29 01 00 00 00 00 02 C0 09
			29 01 00 00 00 00 03 C8 07 38
			29 01 00 00 00 00 06 D1 00 05 01 00 00
			29 01 00 00 00 00 02 E5 03
			29 01 00 00 00 00 02 E6 03
			29 01 00 00 00 00 02 E9 03
			29 01 00 00 00 00 02 EA 03
			29 01 00 00 00 00 06 F0 55 AA 52 08 06
			29 01 00 00 00 00 03 B0 2D 2D
			29 01 00 00 00 00 03 B1 01 01
			29 01 00 00 00 00 03 B2 34 34
			29 01 00 00 00 00 03 B3 2E 2E
			29 01 00 00 00 00 03 B4 2E 2D
			29 01 00 00 00 00 03 B5 2D 13
			29 01 00 00 00 00 03 B6 13 11
			29 01 00 00 00 00 03 B7 11 36
			29 01 00 00 00 00 03 B8 36 15
			29 01 00 00 00 00 03 B9 15 2E
			29 01 00 00 00 00 03 BA 2E 14
			29 01 00 00 00 00 03 BB 14 35
			29 01 00 00 00 00 03 BC 35 10
			29 01 00 00 00 00 03 BD 10 12
			29 01 00 00 00 00 03 BE 12 2D
			29 01 00 00 00 00 03 BF 2D 2E
			29 01 00 00 00 00 03 C0 2E 2E
			29 01 00 00 00 00 03 C1 34 34
			29 01 00 00 00 00 03 C2 00 00
			29 01 00 00 00 00 03 C3 2D 2D
			29 01 00 00 00 00 03 C4 2E 2E
			29 01 00 00 00 00 03 C5 00 00
			29 01 00 00 00 00 03 C6 34 34
			29 01 00 00 00 00 03 C7 2D 2D
			29 01 00 00 00 00 03 C8 2E 2D
			29 01 00 00 00 00 03 C9 2D 14
			29 01 00 00 00 00 03 CA 14 35
			29 01 00 00 00 00 03 CB 35 10
			29 01 00 00 00 00 03 CC 10 12
			29 01 00 00 00 00 03 CD 12 2E
			29 01 00 00 00 00 03 CE 2E 13
			29 01 00 00 00 00 03 CF 13 11
			29 01 00 00 00 00 03 D0 11 36
			29 01 00 00 00 00 03 D1 36 15
			29 01 00 00 00 00 03 D2 15 2D
			29 01 00 00 00 00 03 D3 2D 2E
			29 01 00 00 00 00 03 D4 2D 2D
			29 01 00 00 00 00 03 D5 34 34
			29 01 00 00 00 00 03 D6 01 01
			29 01 00 00 00 00 03 D7 2E 2E
			29 01 00 00 00 00 06 D8 00 00 00 00 00
			29 01 00 00 00 00 06 D9 00 00 00 00 00
			29 01 00 00 00 00 03 E5 34 34
			29 01 00 00 00 00 03 E6 34 34
			29 01 00 00 00 00 03 E8 34 34
			29 01 00 00 00 00 03 E9 34 34
			29 01 00 00 00 00 06 F0 55 AA 52 00 00
			29 01 00 00 00 00 02 35 00
			29 01 00 00 00 00 02 62 01
			05 01 00 00 78 00 02 11 00
			05 01 00 00 14 00 02 29 00];

		qcom,mdss-dsi-off-command = [05 01 00 00 14 00 02 28 00
					     05 01 00 00 78 00 02 10 00];
		qcom,mdss-dsi-on-command-state = "dsi_lp_mode";
		qcom,mdss-dsi-off-command-state = "dsi_hs_mode";
		qcom,mdss-dsi-h-sync-pulse = <1>;
		qcom,mdss-dsi-traffic-mode = "burst_mode";
		qcom,mdss-dsi-lane-map = "lane_map_0123";
		qcom,mdss-dsi-bllp-eof-power-mode;
		qcom,mdss-dsi-bllp-power-mode;
		qcom,mdss-dsi-hfp-power-mode;
		qcom,mdss-dsi-lane-0-state;
		qcom,mdss-dsi-lane-1-state;
		qcom,mdss-dsi-lane-2-state;
		qcom,mdss-dsi-lane-3-state;
		qcom,mdss-dsi-panel-timings = [87 1C 12 00 42 44 18 20 17 03 04 00];
		qcom,mdss-dsi-t-clk-post = <0x02>;
		qcom,mdss-dsi-t-clk-pre = <0x34>;
		qcom,mdss-dsi-bl-min-level = <1>;
		qcom,mdss-dsi-bl-max-level = <4095>;
		qcom,mdss-dsi-dma-trigger = "trigger_sw";
		qcom,mdss-dsi-mdp-trigger = "none";
		qcom,mdss-dsi-force-clock-lane-hs;
		qcom,mdss-dsi-bl-pmic-control-type = "bl_ctrl_wled";
		qcom,mdss-dsi-reset-sequence = <1 20>, <0 2>, <1 20>;
		qcom,mdss-dsi-lp11-init;
		qcom,mdss-dsi-init-delay-us = <50000>;
                qcom,esd-check-enabled;
		qcom,mdss-dsi-panel-status-command = [06 01 00 01 05 00 01 0A];
		qcom,mdss-dsi-panel-status-command-mode = "dsi_lp_mode";
		qcom,mdss-dsi-panel-status-check-mode = "reg_read";
		qcom,mdss-dsi-panel-status-read-length = <1>;
		qcom,mdss-dsi-panel-status-value = <0x9C>;
		qcom,mdss-dsi-panel-max-error-count = <3>;
		qcom,mdss-pan-physical-width-dimension = <135>;
		qcom,mdss-pan-physical-height-dimension = <216>;
	};
};
