/* Copyright (c) 2013, The Linux Foundation. All rights reserved.
 *
 * This program is free software; you can redistribute it and/or modify
 * it under the terms of the GNU General Public License version 2 and
 * only version 2 as published by the Free Software Foundation.
 *
 * This program is distributed in the hope that it will be useful,
 * but WITHOUT ANY WARRANTY; without even the implied warranty of
 * MERCHANTABILITY or FITNESS FOR A PARTICULAR PURPOSE.  See the
 * GNU General Public License for more details.
 */

/*---------------------------------------------------------------------------
 * This file is autogenerated file using gcdb parser. Please do not edit it.
 * Update input XML file to add a new entry or update variable in this file
 * VERSION = "1.0"
 *---------------------------------------------------------------------------*/
&mdss_mdp {
	dsi_jd9364_boe_video: qcom,mdss_dsi_jd9364_boe_video {
		qcom,mdss-dsi-panel-name = "mdss_dsi_jd9364_boe_video";
		qcom,mdss-dsi-panel-controller = <&mdss_dsi0>;
		qcom,mdss-dsi-panel-type = "dsi_video_mode";
		qcom,mdss-dsi-panel-destination = "display_1";
		qcom,mdss-dsi-panel-orientation = "0";
		qcom,mdss-dsi-panel-framerate = <58>;
		qcom,mdss-dsi-virtual-channel-id = <0>;
		qcom,mdss-dsi-stream = <0>;
		qcom,mdss-dsi-panel-width = <800>;
		qcom,mdss-dsi-panel-height = <1280>;
		qcom,mdss-dsi-h-front-porch = <40>;
		qcom,mdss-dsi-h-back-porch = <20>;
		qcom,mdss-dsi-h-pulse-width = <20>;
		qcom,mdss-dsi-h-sync-skew = <0>;
		qcom,mdss-dsi-v-back-porch = <8>;
		qcom,mdss-dsi-v-front-porch = <8>;
		qcom,mdss-dsi-v-pulse-width = <4>;
		qcom,mdss-dsi-h-left-border = <0>;
		qcom,mdss-dsi-h-right-border = <0>;
		qcom,mdss-dsi-v-top-border = <0>;
		qcom,mdss-dsi-v-bottom-border = <0>;
		qcom,mdss-dsi-bpp = <24>;
		qcom,mdss-dsi-color-order = "rgb_swap_rgb";
		qcom,mdss-dsi-underflow-color = <0xff>;
		qcom,mdss-dsi-border-color = <0>;
		qcom,mdss-dsi-on-command = [39 01 00 00 00 00 02 E0 00
			39 01 00 00 00 00 02 E1 93
			39 01 00 00 00 00 02 E2 65
			39 01 00 00 00 00 02 E3 F8
			39 01 00 00 00 00 02 80 03
			39 01 00 00 00 00 02 E0 01
			39 01 00 00 00 00 02 00 00
			39 01 00 00 00 00 02 01 6F
			39 01 00 00 00 00 02 03 00
			39 01 00 00 00 00 02 04 6A
			39 01 00 00 00 00 02 17 00
			39 01 00 00 00 00 02 18 AF
			39 01 00 00 00 00 02 19 01
			39 01 00 00 00 00 02 1A 00
			39 01 00 00 00 00 02 1B AF
			39 01 00 00 00 00 02 1C 01
			39 01 00 00 00 00 02 1F 3E
			39 01 00 00 00 00 02 20 28
			39 01 00 00 00 00 02 21 28
			39 01 00 00 00 00 02 22 7E
			39 01 00 00 00 00 02 35 26
			39 01 00 00 00 00 02 37 05
			39 01 00 00 00 00 02 38 04
			39 01 00 00 00 00 02 39 00
			39 01 00 00 00 00 02 3A 01
			39 01 00 00 00 00 02 3C 7C
			39 01 00 00 00 00 02 3D FF
			39 01 00 00 00 00 02 3E FF
			39 01 00 00 00 00 02 3F 7F
			39 01 00 00 00 00 02 40 06
			39 01 00 00 00 00 02 41 A0
			39 01 00 00 00 00 02 42 81
			39 01 00 00 00 00 02 43 08
			39 01 00 00 00 00 02 44 0B
			39 01 00 00 00 00 02 45 28
			39 01 00 00 00 00 02 55 0F
			39 01 00 00 00 00 02 57 69
			39 01 00 00 00 00 02 59 0A
			39 01 00 00 00 00 02 5A 28
			39 01 00 00 00 00 02 5B 14
			39 01 00 00 00 00 02 5D 7C
			39 01 00 00 00 00 02 5E 65
			39 01 00 00 00 00 02 5F 55
			39 01 00 00 00 00 02 60 47
			39 01 00 00 00 00 02 61 43
			39 01 00 00 00 00 02 62 32
			39 01 00 00 00 00 02 63 34
			39 01 00 00 00 00 02 64 1C
			39 01 00 00 00 00 02 65 33
			39 01 00 00 00 00 02 66 31
			39 01 00 00 00 00 02 67 30
			39 01 00 00 00 00 02 68 4E
			39 01 00 00 00 00 02 69 3C
			39 01 00 00 00 00 02 6A 44
			39 01 00 00 00 00 02 6B 35
			39 01 00 00 00 00 02 6C 31
			39 01 00 00 00 00 02 6D 23
			39 01 00 00 00 00 02 6E 11
			39 01 00 00 00 00 02 6F 00
			39 01 00 00 00 00 02 70 7C
			39 01 00 00 00 00 02 71 65
			39 01 00 00 00 00 02 72 55
			39 01 00 00 00 00 02 73 47
			39 01 00 00 00 00 02 74 43
			39 01 00 00 00 00 02 75 32
			39 01 00 00 00 00 02 76 34
			39 01 00 00 00 00 02 77 1C
			39 01 00 00 00 00 02 78 33
			39 01 00 00 00 00 02 79 31
			39 01 00 00 00 00 02 7A 30
			39 01 00 00 00 00 02 7B 4E
			39 01 00 00 00 00 02 7C 3C
			39 01 00 00 00 00 02 7D 44
			39 01 00 00 00 00 02 7E 35
			39 01 00 00 00 00 02 7F 31
			39 01 00 00 00 00 02 80 23
			39 01 00 00 00 00 02 81 11
			39 01 00 00 00 00 02 82 00
			39 01 00 00 00 00 02 E0 02
			39 01 00 00 00 00 02 00 1E
			39 01 00 00 00 00 02 01 1E
			39 01 00 00 00 00 02 02 41
			39 01 00 00 00 00 02 03 41
			39 01 00 00 00 00 02 04 1F
			39 01 00 00 00 00 02 05 1F
			39 01 00 00 00 00 02 06 1F
			39 01 00 00 00 00 02 07 1F
			39 01 00 00 00 00 02 08 1F
			39 01 00 00 00 00 02 09 1F
			39 01 00 00 00 00 02 0A 1E
			39 01 00 00 00 00 02 0B 1E
			39 01 00 00 00 00 02 0C 1F
			39 01 00 00 00 00 02 0D 47
			39 01 00 00 00 00 02 0E 47
			39 01 00 00 00 00 02 0F 45
			39 01 00 00 00 00 02 10 45
			39 01 00 00 00 00 02 11 4B
			39 01 00 00 00 00 02 12 4B
			39 01 00 00 00 00 02 13 49
			39 01 00 00 00 00 02 14 49
			39 01 00 00 00 00 02 15 1F
			39 01 00 00 00 00 02 16 1E
			39 01 00 00 00 00 02 17 1E
			39 01 00 00 00 00 02 18 40
			39 01 00 00 00 00 02 19 40
			39 01 00 00 00 00 02 1A 1F
			39 01 00 00 00 00 02 1B 1F
			39 01 00 00 00 00 02 1C 1F
			39 01 00 00 00 00 02 1D 1F
			39 01 00 00 00 00 02 1E 1F
			39 01 00 00 00 00 02 1F 1F
			39 01 00 00 00 00 02 20 1E
			39 01 00 00 00 00 02 21 1E
			39 01 00 00 00 00 02 22 1f
			39 01 00 00 00 00 02 23 46
			39 01 00 00 00 00 02 24 46
			39 01 00 00 00 00 02 25 44
			39 01 00 00 00 00 02 26 44
			39 01 00 00 00 00 02 27 4A
			39 01 00 00 00 00 02 28 4A
			39 01 00 00 00 00 02 29 48
			39 01 00 00 00 00 02 2A 48
			39 01 00 00 00 00 02 2B 1F
			39 01 00 00 00 00 02 2C 1F
			39 01 00 00 00 00 02 2D 1F
			39 01 00 00 00 00 02 2E 40
			39 01 00 00 00 00 02 2F 40
			39 01 00 00 00 00 02 30 1F
			39 01 00 00 00 00 02 31 1F
			39 01 00 00 00 00 02 32 1E
			39 01 00 00 00 00 02 33 1E
			39 01 00 00 00 00 02 34 1F
			39 01 00 00 00 00 02 35 1F
			39 01 00 00 00 00 02 36 1E
			39 01 00 00 00 00 02 37 1E
			39 01 00 00 00 00 02 38 1F
			39 01 00 00 00 00 02 39 48
			39 01 00 00 00 00 02 3A 48
			39 01 00 00 00 00 02 3B 4A
			39 01 00 00 00 00 02 3C 4A
			39 01 00 00 00 00 02 3D 44
			39 01 00 00 00 00 02 3E 44
			39 01 00 00 00 00 02 3F 46
			39 01 00 00 00 00 02 40 46
			39 01 00 00 00 00 02 41 1F
			39 01 00 00 00 00 02 42 1F
			39 01 00 00 00 00 02 43 1F
			39 01 00 00 00 00 02 44 41
			39 01 00 00 00 00 02 45 41
			39 01 00 00 00 00 02 46 1F
			39 01 00 00 00 00 02 47 1F
			39 01 00 00 00 00 02 48 1E
			39 01 00 00 00 00 02 49 1E
			39 01 00 00 00 00 02 4A 1E
			39 01 00 00 00 00 02 4B 1F
			39 01 00 00 00 00 02 4C 1E
			39 01 00 00 00 00 02 4D 1E
			39 01 00 00 00 00 02 4E 1F
			39 01 00 00 00 00 02 4F 49
			39 01 00 00 00 00 02 50 49
			39 01 00 00 00 00 02 51 4B
			39 01 00 00 00 00 02 52 4B
			39 01 00 00 00 00 02 53 45
			39 01 00 00 00 00 02 54 45
			39 01 00 00 00 00 02 55 47
			39 01 00 00 00 00 02 56 47
			39 01 00 00 00 00 02 57 1F
			39 01 00 00 00 00 02 58 40
			39 01 00 00 00 00 02 5B 30
			39 01 00 00 00 00 02 5C 03
			39 01 00 00 00 00 02 5D 30
			39 01 00 00 00 00 02 5E 01
			39 01 00 00 00 00 02 5F 02
			39 01 00 00 00 00 02 63 14
			39 01 00 00 00 00 02 64 6A
			39 01 00 00 00 00 02 67 73
			39 01 00 00 00 00 02 68 05
			39 01 00 00 00 00 02 69 14
			39 01 00 00 00 00 02 6A 6A
			39 01 00 00 00 00 02 6B 08
			39 01 00 00 00 00 02 6C 00
			39 01 00 00 00 00 02 6D 00
			39 01 00 00 00 00 02 6E 00
			39 01 00 00 00 00 02 6F 88
			39 01 00 00 00 00 02 77 DD
			39 01 00 00 00 00 02 79 0E
			39 01 00 00 00 00 02 7A 03
			39 01 00 00 00 00 02 7D 14
			39 01 00 00 00 00 02 7E 6A
			39 01 00 00 00 00 02 E0 03
			39 01 00 00 00 00 02 AF 20
			39 01 00 00 00 00 02 A0 33
			39 01 00 00 00 00 02 A9 81
			39 01 00 00 00 00 02 E0 04
			39 01 00 00 00 00 02 09 11
			39 01 00 00 00 00 02 0E 48
			39 01 00 00 00 00 02 2B 2B
			39 01 00 00 00 00 02 2D 03
			39 01 00 00 00 00 02 2E 44
			39 01 00 00 00 00 02 41 FF
			39 01 00 00 00 00 02 E0 00
			39 01 00 00 00 00 02 E6 02
			39 01 00 00 00 00 02 E7 0C
			39 01 00 00 00 00 02 35 00
			05 01 00 00 78 00 02 11 00
			05 01 00 00 14 00 02 29 00];
		qcom,mdss-dsi-off-command = [39 01 00 00 01 00 02 E0 00
		39 01 00 00 00 00 02 E1 93
		39 01 00 00 00 00 02 E2 65
		39 01 00 00 00 00 02 E3 F8
		39 01 00 00 32 00 02 28 00
		39 01 00 00 78 00 02 10 00];
		qcom,mdss-dsi-on-command-state = "dsi_lp_mode";
		qcom,mdss-dsi-off-command-state = "dsi_lp_mode";
		qcom,mdss-dsi-h-sync-pulse = <1>;
		qcom,mdss-dsi-traffic-mode = "burst_mode";
		qcom,mdss-dsi-lane-map = "lane_map_0123";
		qcom,mdss-dsi-bllp-eof-power-mode;
		qcom,mdss-dsi-bllp-power-mode;
		qcom,mdss-dsi-lane-0-state;
		qcom,mdss-dsi-lane-1-state;
		qcom,mdss-dsi-lane-2-state;
		qcom,mdss-dsi-lane-3-state;
		qcom,mdss-dsi-panel-timings = [8B 1E 14 00 44 48 18 22 19 03 04 00];
		qcom,mdss-dsi-t-clk-post = <0x04>;
		qcom,mdss-dsi-t-clk-pre = <0x1C>;
		qcom,mdss-dsi-bl-min-level = <1>;
		qcom,mdss-dsi-bl-max-level = <4095>;
		qcom,mdss-dsi-dma-trigger = "trigger_sw";
		qcom,mdss-dsi-mdp-trigger = "none";
		qcom,mdss-dsi-bl-pmic-control-type = "bl_ctrl_wled";
		qcom,mdss-dsi-reset-sequence = <1 20>, <0 6>, <1 20>;
	};
};
